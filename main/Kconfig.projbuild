## main/Kconfig.projbuild
```kconfig
menu "Telescope Configuration"

config WIFI_SSID
    string "WiFi ssid name"
	default ""

config WIFI_PASS
    string "WiFi password"
	default ""

config SERVER_PORT
    int "Command listening port"
	range 1 65535
	default 9333

config SERVER_BROADCAST_PORT_START
    int "Status broadcasting start port"
	range 1 65535
	default 9334

config SERVER_BROADCAST_PORT_LENGTH
    int "Status broadcasting port count"
	range 1 16
	default 4

config DISPLAY_SCL
	int "Display OLED SCL pin"
	range 0 34
	default 19

config DISPLAY_SDA
	int "Display OLED SDA pin"
	range 0 34
	default 22

config GPIO_TRACK_PIN
	int "Track control pin"
	range 0 34
	default 2

menu "Right Ascension"

config GPIO_RA_RENCODER_A
    int "Rotatry encoder phase A"
	range 0 34
	default 0

config GPIO_RA_RENCODER_B
    int "Rotatry encoder phase B"
	range 0 34
	default 2

config GPIO_RA_RENCODER_PULSES
    int "Rotatry encoder pulses per cycle"
	default 2400

config RA_BACKLASH_PULSES
    int "Axis backlash pulses in rotatry encoder"
	default 23

config GPIO_RA_EN
    int "Motor EN pin"
	range 0 34
	default 12

config GPIO_RA_PUL
    int "Motor PUL/STEP pin"
	range 0 34
	default 13

config GPIO_RA_DIR
    int "Motor DIR pin"
	range 0 34
	default 14

config RA_RESOLUTION
	int "Motor Resolution (pulses per step)"
	default 16

config RA_CYCLE_STEPS
	int "Motor Steps per Cycle"
	default 5760

config RA_GEAR_RATIO
	int "Axis Gear Ratio (slow down > 1)"
	default 130

config RA_REVERSE
	bool "Reverse Motor"
	default false

config RA_REVERSE_RENCODER
	bool "Reverse Rotatry Encoder"
	default false

endmenu

menu "Declination"

config GPIO_DEC_RENCODER_A
    int "Rotatry encoder phase A"
	range 0 34
	default 16

config GPIO_DEC_RENCODER_B
    int "Rotatry encoder phase B"
	range 0 34
	default 17

config GPIO_DEC_RENCODER_PULSES
    int "Rotatry encoder pulses per cycle"
	default 2400

config DEC_BACKLASH_PULSES
    int "Axis backlash pulses in rotatry encoder"
	default 21

config GPIO_DEC_EN
    int "Motor EN pin"
	range 0 34
	default 12

config GPIO_DEC_PUL
    int "Motor PUL/STEP pin"
	range 0 34
	default 13

config GPIO_DEC_DIR
    int "Motor DIR pin"
	range 0 34
	default 14

config DEC_RESOLUTION
	int "Motor Resolution (pulses per step)"
	default 16

config DEC_CYCLE_STEPS
	int "Motor Steps per Cycle"
	default 5760

config DEC_GEAR_RATIO
	int "Axis Gear ratio (slow down > 1)"
	default 130	

config DEC_REVERSE
	bool "Reverse Motor"
	default false

config DEC_REVERSE_RENCODER
	bool "Reverse Rotatry Encoder"
	default false

endmenu

menu "Focuser"

config GPIO_FOCUS_IN1
	int "GPIO of ULN2003 IN1"
	default 5

config GPIO_FOCUS_IN2
	int "GPIO of ULN2003 IN2"
	default 18

config GPIO_FOCUS_IN3
	int "GPIO of ULN2003 IN3"
	default 21

config GPIO_FOCUS_IN4
	int "GPIO of ULN2003 IN4"
	default 23

config FOCUS_TOTAL_MOVEMENT_MICRONS
	int "Total available movement distance"
	default 48000

config FOCUS_MOVEMENT_MICRONS_PER_CYCLE
    int "Movement distance during motor run one cycle"
	default 12566

config FOCUS_STEPS_PER_CYCLE
    int "Steps for focus motor to move one cycle"
	default 16384

config FOCUS_MOVEMENT_SPEED_MICRONS_PER_SECOND
	int "Focuser movement speed in microns per meter"
	default 500

endmenu

endmenu
```
